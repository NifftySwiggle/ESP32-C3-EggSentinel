// ================================================================
//  EGG SENTINEL — Wi-Fi Setup Page (captive portal)
//  Deliberately PLAIN HTML FORM, NO JAVASCRIPT for the save action.
//  Captive-portal mini-browsers (the popup that appears automatically
//  when you join a Wi-Fi hotspot) often restrict or don't fully run
//  JavaScript, which is why fetch()-based saves can silently do
//  nothing. A plain <form method="POST"> always works because it's
//  just a normal HTTP request the browser handles natively.
// ================================================================
#pragma once

const char SETUP_HTML_TOP[] PROGMEM = R"HTMLPAGE(
<!DOCTYPE html>
<html lang="en">
<head>
<meta charset="UTF-8">
<meta name="viewport" content="width=device-width, initial-scale=1.0, maximum-scale=1.0">
<title>Egg Sentinel Setup</title>
<style>
  body {
    margin: 0; padding: 24px; background: #0b0d12; color: #e6e9ef;
    font-family: -apple-system, BlinkMacSystemFont, "Segoe UI", Roboto, sans-serif;
  }
  .wrap { max-width: 380px; margin: 0 auto; }
  h1 { font-size: 22px; margin: 8px 0 4px; }
  .sub { color: #8b93a7; font-size: 13px; margin-bottom: 22px; line-height: 1.5; }
  .card {
    background: #12151c; border: 1px solid #232834; border-radius: 12px;
    padding: 18px; margin-bottom: 16px;
  }
  label { display: block; font-size: 12px; color: #8b93a7; margin-bottom: 6px; margin-top: 12px; }
  input, select {
    width: 100%; background: #0b0d12; border: 1px solid #232834; color: #e6e9ef;
    padding: 12px; border-radius: 8px; font-size: 15px; box-sizing: border-box;
    font-family: inherit;
  }
  input:focus, select:focus { outline: none; border-color: #5b8cff; }
  button {
    width: 100%; background: #5b8cff; color: white; border: none; border-radius: 8px;
    padding: 14px; font-size: 15px; font-weight: 700; margin-top: 18px;
  }
  button.rescan {
    background: transparent; border: 1px solid #232834; color: #8b93a7;
    font-weight: 600; padding: 10px; margin-top: 8px; font-size: 13px;
  }
  .hint { font-size: 11px; color: #8b93a7; margin-top: 10px; line-height: 1.5; }
  footer { color: #8b93a7; font-size: 11px; text-align: center; margin-top: 20px; line-height: 1.6; }
</style>
</head>
<body>
<div class="wrap">
  <h1>🥚 Egg Sentinel Setup</h1>
  <div class="sub">Pick your home Wi-Fi network below, or type the name manually if it's not listed. The egg will restart and join your network.</div>

  <!--
    PLAIN FORM POST — no JavaScript, no fetch(). The browser submits
    this exactly like any normal web form, which is what makes it
    work reliably inside the small captive-portal popup browser.

    The network list below (the <datalist>) was generated by the EGG
    ITSELF scanning nearby Wi-Fi right before sending this page — not
    by JavaScript running in your browser. Combined with the
    <input list="..."> field, this gives you a single box that lets
    you EITHER tap a nearby network from the list OR type any name
    manually (e.g. a hidden network) — entirely through native HTML,
    no JavaScript involved anywhere in this mechanism.
  -->
  <form method="POST" action="/save">
    <div class="card">
      <label for="ssid">Wi-Fi network name (SSID)</label>
      <input type="text" id="ssid" name="ssid" list="networks" required autocomplete="off" autocapitalize="off" placeholder="Tap for nearby networks, or type one">
      <datalist id="networks">
)HTMLPAGE";

const char SETUP_HTML_MID[] PROGMEM = R"HTMLPAGE(
      </datalist>

      <label for="pass">Wi-Fi password</label>
      <input type="password" id="pass" name="pass" autocomplete="off">

      <div class="hint">Leave the password blank only if your network is open (no password). If your network doesn't appear in the suggestions, just type its name — hidden networks won't show up in any scan, that's normal.</div>
    </div>

    <div class="card">
      <label for="tgToken">Telegram bot token (optional)</label>
      <input type="text" id="tgToken" name="tgToken" autocomplete="off" placeholder="123456789:AAH...">

      <label for="tgChat">Telegram chat ID (optional)</label>
      <input type="text" id="tgChat" name="tgChat" autocomplete="off" placeholder="987654321">

      <div class="hint">
        Don't have these? Message <strong>@BotFather</strong> on Telegram and send
        <strong>/newbot</strong> to get a token, then message <strong>@userinfobot</strong>
        for your chat ID. You can skip this and add it later from the dashboard instead.
      </div>
    </div>

    <button type="submit">Connect &amp; finish setup</button>
  </form>

  <form method="GET" action="/">
    <button type="submit" class="rescan">🔄 Rescan for networks</button>
  </form>

  <footer>
    After saving, the egg restarts and joins your network.<br>
    Find the dashboard afterward at <strong>http://eggsentinel.local</strong>
  </footer>
</div>
</body>
</html>
)HTMLPAGE";

// ----------------------------------------------------------------
//  Shown after the form is submitted — confirms the save and tells
//  the person what to do next (still plain HTML, no JS needed).
// ----------------------------------------------------------------
const char SETUP_SAVED_HTML[] PROGMEM = R"HTMLPAGE(
<!DOCTYPE html>
<html lang="en">
<head>
<meta charset="UTF-8">
<meta name="viewport" content="width=device-width, initial-scale=1.0">
<title>Egg Sentinel — Saved</title>
<style>
  body {
    margin: 0; padding: 24px; background: #0b0d12; color: #e6e9ef;
    font-family: -apple-system, BlinkMacSystemFont, "Segoe UI", Roboto, sans-serif;
    text-align: center;
  }
  .wrap { max-width: 380px; margin: 60px auto 0; }
  h1 { font-size: 22px; }
  p { color: #8b93a7; font-size: 14px; line-height: 1.6; }
  strong { color: #e6e9ef; }
</style>
</head>
<body>
<div class="wrap">
  <h1>✅ Saved!</h1>
  <p>
    Egg Sentinel is restarting and connecting to your Wi-Fi network now.
    This setup hotspot will disappear in a few seconds.
  </p>
  <p>
    Once it's connected, reconnect your phone/laptop to your normal Wi-Fi,
    then visit <strong>http://eggsentinel.local</strong> to open the dashboard.
  </p>
  <p>
    If that address doesn't load, check your router's device list for
    "EggSentinel" to find its IP address instead.
  </p>
</div>
</body>
</html>
)HTMLPAGE";

// ----------------------------------------------------------------
//  Shown if the saved Wi-Fi network doesn't have a name (shouldn't
//  normally happen since the form requires it, but covers a
//  malformed/empty POST gracefully instead of just failing silently).
// ----------------------------------------------------------------
const char SETUP_ERROR_HTML[] PROGMEM = R"HTMLPAGE(
<!DOCTYPE html>
<html lang="en">
<head>
<meta charset="UTF-8">
<meta name="viewport" content="width=device-width, initial-scale=1.0">
<title>Egg Sentinel — Try again</title>
<style>
  body {
    margin: 0; padding: 24px; background: #0b0d12; color: #e6e9ef;
    font-family: -apple-system, BlinkMacSystemFont, "Segoe UI", Roboto, sans-serif;
    text-align: center;
  }
  .wrap { max-width: 380px; margin: 60px auto 0; }
  h1 { font-size: 22px; color: #ff6b6b; }
  p { color: #8b93a7; font-size: 14px; line-height: 1.6; }
  a { color: #5b8cff; text-decoration: none; font-weight: 600; }
</style>
</head>
<body>
<div class="wrap">
  <h1>⚠️ Network name required</h1>
  <p>Please enter your Wi-Fi network name to continue.</p>
  <p><a href="/">&larr; Go back and try again</a></p>
</div>
</body>
</html>
)HTMLPAGE";
